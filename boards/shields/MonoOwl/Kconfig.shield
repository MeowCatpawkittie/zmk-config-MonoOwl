## boards/shields/MonoOwl/Kconfig.shield
```kconfig
config SHIELD_MONOOWL_R
    def_bool $(shields_list_contains,MonoOwl_R)

config SHIELD_MONOOWL_L
    def_bool $(shields_list_contains,MonoOwl_L)
```
